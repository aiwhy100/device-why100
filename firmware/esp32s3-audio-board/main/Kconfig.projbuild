## firmware/esp32s3-audio-board/main/Kconfig.projbuild
```kconfig
menu "AI为什么100"

    comment "Defaults only. Settings saved from the phone setup page (portal) take precedence."

    config WHY_WIFI_SSID
        string "WiFi SSID (2.4 GHz)"
        default ""

    config WHY_WIFI_PASS
        string "WiFi password"
        default ""

    choice WHY_MODE
        prompt "Connection mode"
        default WHY_MODE_DIRECT
        help
            Direct: the device calls api.aiwhy100.com with a personal API key.
            Gateway: the device talks to your own gateway (device-why100/gateway), which holds the key.

        config WHY_MODE_DIRECT
            bool "Direct to AI为什么100 (personal API key)"
        config WHY_MODE_GATEWAY
            bool "Self-hosted gateway"
    endchoice

    config WHY_API_KEY
        string "API key (direct mode, svf_live_...)"
        default ""

    config WHY_SERVER_URL
        string "Server URL (direct: empty = https://api.aiwhy100.com; gateway: http://<IP>:8080)"
        default ""

    config WHY_DEVICE_TOKEN
        string "Device token (gateway mode, optional)"
        default ""

endmenu
```

## firmware/esp32s3-audio-board/sdkconfig.defaults
```kconfig
CONFIG_IDF_TARGET="esp32s3"
CONFIG_ESPTOOLPY_FLASHSIZE_16MB=y
CONFIG_ESPTOOLPY_FLASHMODE_DIO=y
CONFIG_PARTITION_TABLE_CUSTOM=y
CONFIG_PARTITION_TABLE_CUSTOM_FILENAME="partitions.csv"
CONFIG_SPIRAM=y
CONFIG_SPIRAM_MODE_OCT=y
CONFIG_SPIRAM_SPEED_80M=y
CONFIG_ESP_DEFAULT_CPU_FREQ_MHZ_240=y
CONFIG_ESP_CONSOLE_USB_SERIAL_JTAG=y
CONFIG_ESP_MAIN_TASK_STACK_SIZE=12288
CONFIG_FREERTOS_HZ=1000
# HTTPS（直连 api.aiwhy100.com）：用内置的根证书包；TLS 缓冲放到 PSRAM
CONFIG_MBEDTLS_CERTIFICATE_BUNDLE=y
CONFIG_MBEDTLS_CERTIFICATE_BUNDLE_DEFAULT_FULL=y
CONFIG_MBEDTLS_EXTERNAL_MEM_ALLOC=y
# 配网网页的请求头（手机浏览器的 Cookie / UA 比较长）
CONFIG_HTTPD_MAX_REQ_HDR_LEN=1024
CONFIG_HTTPD_MAX_URI_LEN=1024
```
